## CMakeLists.txt
```
#
# Copyright (c) 2018 Nordic Semiconductor
#
# SPDX-License-Identifier: LicenseRef-BSD-5-Clause-Nordic
#

cmake_minimum_required(VERSION 3.13.1)

# This sample runs as a non-secure application on nRF91. Therefore, it
# requires the secure_partition_manager that prepares the required
# peripherals to be available for the application.
#

  find_package(Zephyr REQUIRED HINTS $ENV{ZEPHYR_BASE})
  project(NONE)

# NORDIC SDK APP START
target_sources(app PRIVATE src/main.c)
# NORDIC SDK APP END
```

## sample.yaml
```
sample:
  name: Uart Test
tests:
  samples.nrf9160.lte_ble_gateway:
    build_only: true
    build_on_all: true
    platform_whitelist: nrf9160dk_nrf9160ns
    tags: ci_build
```

## prj.conf
```kconfig
#
# Copyright (c) 2020 Nordic Semiconductor ASA
#
# SPDX-License-Identifier: LicenseRef-BSD-5-Clause-Nordic
#

# Memory
CONFIG_MAIN_STACK_SIZE=4096
CONFIG_HEAP_MEM_POOL_SIZE=2048

CONFIG_SERIAL=y
CONFIG_UART_ASYNC_API=y
CONFIG_UART_INTERRUPT_DRIVEN=y

CONFIG_NET_BUF=y
```

## nrf9160dk_nrf9160ns.overlay
```dts
&uart1 {
	compatible = "nordic,nrf-uarte";
	current-speed = <115200>;
	status = "okay";
	hw-flow-control;
	tx-pin = <18>;
	rx-pin = <17>;
	rts-pin = <21>;
	cts-pin = <19>;
};
```

## src/main.c
```c
/*
 * Copyright (c) 2018 Nordic Semiconductor ASA
 *
 * SPDX-License-Identifier: LicenseRef-BSD-5-Clause-Nordic
 */

#include <zephyr.h>
#include <stdio.h>
#include <string.h>
#include <drivers/uart.h>
#include <net/buf.h>
#include <net/mqtt.h>
#include <sys/crc.h>

#define CHECKSUM_SIZE 2

/* Uart device */
static struct device *uart_dev;

/* Tx thread for Uart */
static K_THREAD_STACK_DEFINE(tx_thread_stack, 1536);
static struct k_thread tx_thread_data;
static K_FIFO_DEFINE(tx_queue);

NET_BUF_POOL_VAR_DEFINE(uart_pool, 10, 1024, NULL);

static int uart_read(struct device *uart, uint8_t *buf,
		   size_t len, size_t min)
{
	int total = 0;

	while (len) {
		int rx;

		rx = uart_fifo_read(uart, buf, len);
		if (rx == 0) {
			if (total < min) {
				continue;
			}
			break;
		}

		len -= rx;
		total += rx;
		buf += rx;
	}

	return total;
}

static void uart_isr(struct device *unused, void *user_data)
{
	static struct net_buf *buf;
	static uint8_t remaining;
	static uint8_t preamble_cnt;

	ARG_UNUSED(unused);
	ARG_UNUSED(user_data);

	while (uart_irq_update(uart_dev) &&
	       uart_irq_is_pending(uart_dev)) {
		int read;
		uint16_t checksum;
		if (!uart_irq_rx_ready(uart_dev)) {
			if (uart_irq_tx_ready(uart_dev)) {
				printk("transmit ready\n");
			} else {
				printk("spurious interrupt\n");
			}
			/* Only the UART RX path is interrupt-enabled */
			break;
		}

		if (!remaining && (preamble_cnt < 5)) {
			uint8_t preamble;
			uart_read(uart_dev, &preamble, 1, 0);
			printk("Preamble: %d\n", preamble);
			if (preamble == 0xFF) {
				preamble_cnt++;
			} else {
				preamble_cnt = 0;
			}
			continue;
		}

		/* Beginning of a new packet */
		if (!remaining) {
			uart_read(uart_dev, &remaining, 1, 0);
			buf = net_buf_alloc_len(&uart_pool, remaining - CHECKSUM_SIZE,
						    K_NO_WAIT);
			printk("Rem: %d\n", remaining);
		}

		if (remaining > CHECKSUM_SIZE) {
			read = uart_read(uart_dev, net_buf_tail(buf), remaining,
					 0);
			buf->len += read;
			remaining -= read;
		} else if (remaining > 0) {
			read = uart_read(uart_dev, &checksum, sizeof(checksum),
					 2);
			remaining -= read;
		}

		if (!remaining) {
			if (crc16_ansi(buf->data, buf->len) == checksum) {
				printk("Correct Checksum\n");
				net_buf_put(&tx_queue, buf);

			} else {
				net_buf_unref(buf);
				printk("Invalid Checksum\n");
			}
			buf = NULL;
			preamble_cnt = 0;
		}
	}
}

static void tx_thread(void *p1, void *p2, void *p3)
{
	while (1) {
		struct net_buf *get_buf = net_buf_get(&tx_queue, K_FOREVER);

		for (size_t i = get_buf->len; i > 0; i--) {
			printk("%d-", net_buf_pull_u8(get_buf));
		}
		printk("\n");
		printk("\n");

		net_buf_unref(get_buf);
		k_yield();
	}
}

static void uart_cfg_read(void)
{
	struct uart_config u_cfg;
	uart_config_get(uart_dev, &u_cfg);
	printk("Baud: %d\n", u_cfg.baudrate);
	printk("Parity: %d\n", u_cfg.parity);
	printk("Stop bits: %d\n", u_cfg.stop_bits);
	printk("Data bits: %d\n", u_cfg.data_bits);
	printk("FC: %d\n", u_cfg.flow_ctrl);
}

static void uart_irq_init(void)
{
	uart_irq_rx_disable(uart_dev);
	uart_irq_tx_disable(uart_dev);
	uart_irq_callback_set(uart_dev, uart_isr);
	uart_irq_rx_enable(uart_dev);
}

static void tx_thread_create(void)
{
	k_thread_create(&tx_thread_data, tx_thread_stack,
			K_THREAD_STACK_SIZEOF(tx_thread_stack), tx_thread,
			NULL, NULL, NULL, K_PRIO_COOP(7), 0, K_NO_WAIT);
	k_thread_name_set(&tx_thread_data, "Uart TX");
}

static void mqtt_send(struct mqtt_publish_param param)
{
	uint8_t preamble[5] = {0xFF, 0xFF, 0xFF, 0xFF, 0xFF};
	uint8_t size = 5 + 8 + param.message.payload.len +
		       param.message.topic.topic.size + CHECKSUM_SIZE;
	printk("%d\n", size);
	uint8_t buf[size + sizeof(size) + sizeof(preamble)];
	uint8_t buf_idx = 0;

	memcpy(buf+buf_idx, preamble, sizeof(preamble));
	buf_idx += sizeof(preamble);

	memcpy(buf+buf_idx, &size, sizeof(size));
	buf_idx += sizeof(size);

	memcpy(buf+buf_idx, &param.message.topic.qos, sizeof(param.message.topic.qos));
	buf_idx += sizeof(param.message.topic.qos);
	memcpy(buf+buf_idx, &param.message_id, sizeof(param.message_id));
	buf_idx += sizeof(param.message_id);

	buf[buf_idx] = param.dup_flag;
	buf_idx += sizeof(uint8_t);
	buf[buf_idx] = param.retain_flag;
	buf_idx += sizeof(uint8_t);

	// memcpy(buf+buf_idx, &param.dup_flag, sizeof(uint8_t));
	// buf_idx += sizeof(uint8_t);
	// memcpy(buf+buf_idx, &param.retain_flag, sizeof(uint8_t));
	// buf_idx += sizeof(uint8_t);

	memcpy(buf+buf_idx, &param.message.topic.topic.size, sizeof(param.message.topic.topic.size));
	buf_idx += sizeof(param.message.topic.topic.size);
	memcpy(buf+buf_idx, param.message.topic.topic.utf8, param.message.topic.topic.size);
	buf_idx += param.message.topic.topic.size;

	memcpy(buf+buf_idx, &param.message.payload.len, sizeof(param.message.payload.len));
	buf_idx += sizeof(param.message.payload.len);
	memcpy(buf+buf_idx, param.message.payload.data, param.message.payload.len);
	buf_idx += param.message.payload.len;

	uint16_t checksum = crc16_ansi(buf + sizeof(size) + sizeof(preamble), size - CHECKSUM_SIZE);
	printk("Checksum: %d\n", checksum);

	memcpy(buf+buf_idx, &checksum, sizeof(checksum));
	buf_idx += sizeof(checksum);

	for (size_t i = 0; i < sizeof(buf); i++) {
		printk("%d-", buf[i]);
	}
	printk("\n");
	// for (size_t i = 0; i < sizeof(buf); i++) {
	// 	printk("%c-", buf[i]);
	// }
	// printk("\n");

	for (int i = 0; i < sizeof(buf); i++) {
		uart_poll_out(uart_dev, buf[i]);
	}
}

void main(void)
{
	printk("The Uart test sample started\n");

	uart_dev = device_get_binding("UART_1");

	uart_cfg_read();
	uart_irq_init();
	tx_thread_create();

	struct mqtt_publish_param param;

	param.message.topic.qos = 1;
	param.message.topic.topic.utf8 = "my/publish/topicqweasd";
	param.message.topic.topic.size = strlen("my/publish/topicqweasd");
	param.message.payload.data = "my_data";
	param.message.payload.len = strlen("my_data");
	param.message_id = 99;
	param.dup_flag = 0;
	param.retain_flag = 0;

	while (1) {
		mqtt_send(param);

		// const struct {
		// 	const uint8_t tot_size;
		// 	const char topic_size;
		// 	const char topic[7];
		// 	const char data_size;
		// 	const char data[15];
		// } __packed mqtt_pkg2 = {
		// 	.tot_size = 24,
		// 	.topic_size = 7,
		// 	.topic = "Anders",
		// 	.data_size = 15,
		// 	.data = "Hestvik Storro",

		// };


		// for (int i = 0; i < sizeof(mqtt_pkg2); i++) {
		// 	uart_poll_out(uart_dev,
		// 		      *(((const uint8_t *)&mqtt_pkg2)+i));
		// }

		// k_sleep(K_MSEC(500));

		// const struct {
		// 	const uint8_t tot_size;
		// 	const char topic_size;
		// 	const char topic[5];
		// 	const char data_size;
		// 	const char data[8];
		// } __packed mqtt_pkg = {
		// 	.tot_size = 15,
		// 	.topic_size = 5,
		// 	.topic = "Erik",
		// 	.data_size = 8,
		// 	.data = "Robstad",

		// };

		// for (int i = 0; i < sizeof(mqtt_pkg); i++) {
		// 	uart_poll_out(uart_dev,
		// 		      *(((const uint8_t *)&mqtt_pkg)+i));
		// }


		k_sleep(K_MSEC(1000));
	}
}
```

## src/slip.h
```c
/**
 * Copyright (c) 2015 - 2019, Nordic Semiconductor ASA
 *
 * All rights reserved.
 *
 * Redistribution and use in source and binary forms, with or without modification,
 * are permitted provided that the following conditions are met:
 *
 * 1. Redistributions of source code must retain the above copyright notice, this
 *    list of conditions and the following disclaimer.
 *
 * 2. Redistributions in binary form, except as embedded into a Nordic
 *    Semiconductor ASA integrated circuit in a product or a software update for
 *    such product, must reproduce the above copyright notice, this list of
 *    conditions and the following disclaimer in the documentation and/or other
 *    materials provided with the distribution.
 *
 * 3. Neither the name of Nordic Semiconductor ASA nor the names of its
 *    contributors may be used to endorse or promote products derived from this
 *    software without specific prior written permission.
 *
 * 4. This software, with or without modification, must only be used with a
 *    Nordic Semiconductor ASA integrated circuit.
 *
 * 5. Any software provided in binary form under this license must not be reverse
 *    engineered, decompiled, modified and/or disassembled.
 *
 * THIS SOFTWARE IS PROVIDED BY NORDIC SEMICONDUCTOR ASA "AS IS" AND ANY EXPRESS
 * OR IMPLIED WARRANTIES, INCLUDING, BUT NOT LIMITED TO, THE IMPLIED WARRANTIES
 * OF MERCHANTABILITY, NONINFRINGEMENT, AND FITNESS FOR A PARTICULAR PURPOSE ARE
 * DISCLAIMED. IN NO EVENT SHALL NORDIC SEMICONDUCTOR ASA OR CONTRIBUTORS BE
 * LIABLE FOR ANY DIRECT, INDIRECT, INCIDENTAL, SPECIAL, EXEMPLARY, OR
 * CONSEQUENTIAL DAMAGES (INCLUDING, BUT NOT LIMITED TO, PROCUREMENT OF SUBSTITUTE
 * GOODS OR SERVICES; LOSS OF USE, DATA, OR PROFITS; OR BUSINESS INTERRUPTION)
 * HOWEVER CAUSED AND ON ANY THEORY OF LIABILITY, WHETHER IN CONTRACT, STRICT
 * LIABILITY, OR TORT (INCLUDING NEGLIGENCE OR OTHERWISE) ARISING IN ANY WAY OUT
 * OF THE USE OF THIS SOFTWARE, EVEN IF ADVISED OF THE POSSIBILITY OF SUCH DAMAGE.
 *
 */
#ifndef SLIP_H__
#define SLIP_H__

#include <stdint.h>
#include <errno.h>

#ifdef __cplusplus
extern "C" {
#endif

/** @file
 *
 * @defgroup slip SLIP encoding and decoding
 * @{
 * @ingroup app_common
 *
 * @brief  This module encodes and decodes SLIP packages.
 *
 * @details The SLIP protocol is described in @linkSLIP.
 */

/** @brief Status information that is used while receiving and decoding a packet. */
typedef enum
{
  SLIP_STATE_DECODING, //!< Ready to receive the next byte.
  SLIP_STATE_ESC_RECEIVED, //!< An ESC byte has been received and the next byte must be decoded differently.
  SLIP_STATE_CLEARING_INVALID_PACKET //!< The received data is invalid and transfer must be restarted.
} slip_read_state_t;

  /** @brief Representation of a SLIP packet. */
typedef struct
{
  slip_read_state_t   state; //!< Current state of the packet (see @ref slip_read_state_t).

  uint8_t             * p_buffer; //!< Decoded data.
  uint32_t            current_index; //!< Current length of the packet that has been received.
  uint32_t            buffer_len; //!< Size of the buffer that is available.
} slip_t;

/**@brief Function for encoding a SLIP packet.
 *
 * The maximum size of the output data is (2*input size + 1) bytes. Ensure that the provided buffer is large enough.
 *
 * @param[in,out]   p_output                The buffer where the encoded SLIP packet is stored. Ensure that it is large enough.
 * @param[in,out]   p_input                 The buffer to be encoded.
 * @param[in,out]   input_length            The length of the input buffer.
 * @param[out]      p_output_buffer_length  The length of the output buffer after the input has been encoded.
 *
 * @retval  NRF_SUCCESS         If the input was successfully encoded into output.
 * @retval  NRF_ERROR_NULL      If one of the provided parameters is NULL.
 */
int slip_encode(uint8_t * p_output,  uint8_t * p_input, uint32_t input_length, uint32_t * p_output_buffer_length);

/**@brief Function for decoding a SLIP packet.
 *
 * The decoded packet is put into @p p_slip::p_buffer. The index and buffer state is updated.
 *
 * Ensure that @p p_slip is properly initialized. The initial state must be set to @ref SLIP_STATE_DECODING.
 *
 * @param[in,out]   p_slip  State of the decoding process.
 * @param[in]       c       Byte to decode.
 *
 * @retval NRF_SUCCESS              If a packet has been parsed. The received packet can be retrieved from @p p_slip.
 * @retval NRF_ERROR_NULL           If @p p_slip is NULL.
 * @retval NRF_ERROR_NO_MEM         If there is no more room in the buffer provided by @p p_slip.
 * @retval NRF_ERROR_BUSY           If the packet has not been parsed completely yet.
 * @retval NRF_ERROR_INVALID_DATA   If the packet is encoded wrong. In this case, @p p_slip::state is set to @ref SLIP_STATE_CLEARING_INVALID_PACKET,
 *                                  and decoding will stay in this state until the END byte is received.
 */
int slip_decode_add_byte(slip_t * p_slip, uint8_t c);

#ifdef __cplusplus
}
#endif

#endif // SLIP_H__

/** @} */
```

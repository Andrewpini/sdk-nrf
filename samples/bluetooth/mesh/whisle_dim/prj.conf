## sample.yaml
```
sample:
  name: Bluetooth Mesh Thingy52 client
  description: Bluetooth Mesh Thingy52 client
tests:
  samples.bluetooth.mesh.whistle_dim:
    build_only: true
    build_on_all: true
    platform_whitelist: nrf52dk_nrf52832 nrf52840dk_nrf52840
    tags: bluetooth ci_build
```

## prj.conf
```kconfig
#
# Copyright (c) 2020 Nordic Semiconductor ASA
#
# SPDX-License-Identifier: LicenseRef-BSD-5-Clause-Nordic
#

# General configuration
CONFIG_SYSTEM_WORKQUEUE_STACK_SIZE=2048
CONFIG_FLASH=y
CONFIG_FLASH_MAP=y
CONFIG_NVS=y
CONFIG_SETTINGS=y
CONFIG_HWINFO=y
CONFIG_LOG=y
CONFIG_USE_SEGGER_RTT=y
CONFIG_LOG_MINIMAL=n
CONFIG_LOG_PRINTK=y

CONFIG_DK_LIBRARY=y
CONFIG_BT_MESH_DK_PROV=y

# I2C
CONFIG_I2C_0=y

# Speaker
CONFIG_PWM=y

# Microphone
CONFIG_NRFX_PDM=y
CONFIG_NEWLIB_LIBC=y
CONFIG_CMSIS_DSP=y
CONFIG_CMSIS_DSP_TRANSFORM=y
CONFIG_CMSIS_DSP_COMPLEXMATH=y

# Bluetooth configuration
CONFIG_BT=y
CONFIG_BT_COMPANY_ID=0x0059
CONFIG_BT_DEVICE_NAME="Thingy:52 Mesh client"
CONFIG_BT_L2CAP_RX_MTU=69
CONFIG_BT_L2CAP_TX_MTU=69
CONFIG_BT_L2CAP_TX_BUF_COUNT=8
CONFIG_BT_LL_SW_SPLIT=y
CONFIG_BT_OBSERVER=y
CONFIG_BT_PERIPHERAL=y
CONFIG_BT_SETTINGS=y

# Disable unused Bluetooth features
CONFIG_BT_CTLR_DUP_FILTER_LEN=0
CONFIG_BT_CTLR_LE_ENC=n
CONFIG_BT_DATA_LEN_UPDATE=n
CONFIG_BT_PHY_UPDATE=n
CONFIG_BT_CTLR_CHAN_SEL_2=n
CONFIG_BT_CTLR_MIN_USED_CHAN=n
CONFIG_BT_CTLR_PRIVACY=n

# Bluetooth Mesh configuration
CONFIG_BT_MESH=y
CONFIG_BT_MESH_RELAY=y
CONFIG_BT_MESH_FRIEND=y
CONFIG_BT_MESH_ADV_BUF_COUNT=13
CONFIG_BT_MESH_TX_SEG_MAX=10
CONFIG_BT_MESH_PB_GATT=y
CONFIG_BT_MESH_GATT_PROXY=y

# Bluetooth Mesh models
CONFIG_BT_MESH_SENSOR_CLI=y
```

## include/fft_analyzer.h
```c
/*
  Copyright (c) 2016 Arduino LLC. All right reserved.

  This library is free software; you can redistribute it and/or
  modify it under the terms of the GNU Lesser General Public
  License as published by the Free Software Foundation; either
  version 2.1 of the License, or (at your option) any later version.

  This library is distributed in the hope that it will be useful,
  but WITHOUT ANY WARRANTY; without even the implied warranty of
  MERCHANTABILITY or FITNESS FOR A PARTICULAR PURPOSE. See the GNU
  Lesser General Public License for more details.

  You should have received a copy of the GNU Lesser General Public
  License along with this library; if not, write to the Free Software
  Foundation, Inc., 51 Franklin St, Fifth Floor, Boston, MA 02110-1301 USA
*/

#ifndef FFT_ANALYZER_H__
#define FFT_ANALYZER_H__

#include <stdbool.h>
#include <stdio.h>
#include <stdlib.h>
#include <sys/printk.h>

#define ARM_MATH_CM0PLUS
#include <arm_math.h>

#define FFT_NO_ERROR 0 /* FFT no error*/
#define FFT_ERROR 1 /* FFT error */

bool fft_analyzer_available();
int fft_analyzer_read(int spectrum[], int size);
int fft_analyzer_configure(int length);
void fft_analyzer_update(const void *buffer, int size);

#endif /* FFT_ANALYZER_H__ */
```

## include/model_handler.h
```c
/*
 * Copyright (c) 2020 Nordic Semiconductor ASA
 *
 * SPDX-License-Identifier: LicenseRef-BSD-5-Clause-Nordic
 */

#ifndef MODEL_HANDLER_H__
#define MODEL_HANDLER_H__

#include <bluetooth/mesh.h>
#include <nrfx_pdm.h>
#include "fft_analyzer.h"

#ifdef __cplusplus
extern "C" {
#endif

#define GREEN_LED 5
#define BLUE_LED 6
#define RED_LED 7
#define MIC_PWR 9
#define SPKR_PWR 29

const struct bt_mesh_comp *model_handler_init(void);

#ifdef __cplusplus
}
#endif

#endif /* MODEL_HANDLER_H__ */
```

## src/fft_analyzer.c
```c
/*
  Copyright (c) 2016 Arduino LLC. All right reserved.

  This library is free software; you can redistribute it and/or
  modify it under the terms of the GNU Lesser General Public
  License as published by the Free Software Foundation; either
  version 2.1 of the License, or (at your option) any later version.

  This library is distributed in the hope that it will be useful,
  but WITHOUT ANY WARRANTY; without even the implied warranty of
  MERCHANTABILITY or FITNESS FOR A PARTICULAR PURPOSE. See the GNU
  Lesser General Public License for more details.

  You should have received a copy of the GNU Lesser General Public
  License along with this library; if not, write to the Free Software
  Foundation, Inc., 51 Franklin St, Fifth Floor, Boston, MA 02110-1301 USA
*/

#include "fft_analyzer.h"

static int _length;
static bool _available;
static int *_sample_buffer;
static int _sample_buffer_size;
static int *_fft_buffer;
static int *_spectrum_buffer;

static arm_rfft_instance_q15 _S15;

bool fft_analyzer_available()
{
	return _available;
}

int fft_analyzer_read(int spectrum[], int size)
{
	if (!_available) {
		return FFT_ERROR;
	}

	if (size > (_length / 2)) {
		size = _length / 2;
	}

	q31_t *dst = (q31_t *)spectrum;
	q15_t *src = (q15_t *)_spectrum_buffer;

	for (int i = 0; i < size; i++) {
		*dst++ = *src++;
	}

	_available = false;

	return size;
}

int fft_analyzer_configure(int length)
{
	_length = length;
	_sample_buffer_size = _length * sizeof(q15_t);

	if (ARM_MATH_SUCCESS != arm_rfft_init_q15(&_S15, _length, 0, 1)) {
		return FFT_ERROR;
	}

	_sample_buffer = (int *)calloc(_sample_buffer_size, 1);
	_spectrum_buffer = (int *)calloc(_length, sizeof(q15_t));

	_fft_buffer = (int *)calloc(_sample_buffer_size * 2, 1);

	if (_sample_buffer == NULL || _spectrum_buffer == NULL ||
	    _fft_buffer == NULL) {
		return FFT_ERROR;
	}

	return FFT_NO_ERROR;
}

void fft_analyzer_update(const void *buffer, int size)
{
	if (size > _sample_buffer_size) {
		// more samples than buffer size, cap
		size = _sample_buffer_size;
	}

	int newSamplesOffset = _sample_buffer_size - size;

	if (newSamplesOffset) {
		// shift over the previous samples
		memmove(_sample_buffer, ((uint8_t *)_sample_buffer) + size,
			newSamplesOffset);
	}

	uint8_t *newSamples = ((uint8_t *)_sample_buffer) + newSamplesOffset;

	memcpy(newSamples, buffer, size);

	arm_rfft_q15(&_S15, (q15_t *)_sample_buffer, (q15_t *)_fft_buffer);
	arm_cmplx_mag_q15((q15_t *)_fft_buffer, (q15_t *)_spectrum_buffer,
			  _length);

	_available = true;
}
```

## src/model_handler.c
```c
/*
 * Copyright (c) 2020 Nordic Semiconductor ASA
 *
 * SPDX-License-Identifier: LicenseRef-BSD-5-Clause-Nordic
 */

#include <bluetooth/bluetooth.h>
#include <bluetooth/mesh/models.h>
#include <drivers/gpio.h>
#include <drivers/pwm.h>
#include <dk_buttons_and_leds.h>
#include "model_handler.h"
#include <drivers/gpio/gpio_sx1509b.h>

static struct device *io_expander;
static struct device *gpio_0;

static struct device *spkr_pwm;
static u32_t pwm_frequency = 880;

nrfx_pdm_config_t pdm_config = NRFX_PDM_DEFAULT_CONFIG(26, 25);
static const int pdm_sampling_freq = 16000;
static const int fft_size = 256;
static int16_t pdm_buffer_a[256];
static int16_t pdm_buffer_b[256];
static const int spectrum_size = fft_size / 2;
static int spectrum[128];
static int avg_freq;

struct rgb {
        uint8_t red;
        uint8_t green;
        uint8_t blue;
};

static const struct rgb colors[13] = {
        { 0,0,0}, //off
        { 255,0,0}, //red
        { 255,15,0}, //orange
        { 255,255,0}, //light yellow
        { 0,255,30}, //light green
        { 0,255,0}, //green
        { 25,100,55}, //neon teal
        { 0,255,255}, //teal
        { 0,0,255}, //blue
        { 255,0,255}, //light purple
        { 80,10,45}, //light pink
        { 255,0,25}, //pink
        { 255,255,255}, //white
};


static struct k_delayed_work microphone_work;

static int nrfx_err_code_check(nrfx_err_t nrfx_err)
{
	if (NRFX_ERROR_BASE_NUM - nrfx_err) {
		return 1;
	} else {
		return 0;
	}
}

static void microphone_work_handler(struct k_work *work)
{
	if (fft_analyzer_available()) {
		int counter = 0;

		fft_analyzer_read(spectrum, spectrum_size);

		/* i = 8 for frequencies from 500 Hz and up */
		for (int i = 8; i < spectrum_size; i++) {
			if (spectrum[i]) {
				if (!counter) {
					avg_freq = ((i * pdm_sampling_freq) /
						    fft_size);
				} else {
					avg_freq = avg_freq +
						   ((((i * pdm_sampling_freq) /
						      fft_size) -
						     avg_freq) /
						    counter);
				}

				counter++;
			}
		}

		if (avg_freq) {
			// printk("Average frequency: %d\n", avg_freq);
		}

                /* Color whistle picker test */
                uint8_t color_idx = (avg_freq - 500) / 115;
                printk("color_idx: %d\n", color_idx);
                sx1509b_set_pwm(io_expander, RED_LED, colors[color_idx].red);
                sx1509b_set_pwm(io_expander, BLUE_LED, colors[color_idx].blue);
                sx1509b_set_pwm(io_expander, GREEN_LED, colors[color_idx].green);


	}

	k_delayed_work_submit(&microphone_work, K_MSEC(200));
}

static void button_handler_cb(u32_t pressed, u32_t changed)
{
	int err;

	if ((pressed & BIT(0))) {
                sx1509b_gpio_pin_onoff(io_expander, MIC_PWR, 1);
		// gpio_port_set_bits_raw(io_expander, BIT(MIC_PWR));

		err = nrfx_err_code_check(nrfx_pdm_start());

		if (err) {
			printk("Error starting PDM\n");
		} else {
			printk("PDM started\n");
		}

		k_delayed_work_submit(&microphone_work, K_NO_WAIT);
	} else if ((!pressed & BIT(0))) {
		// gpio_port_set_bits_raw(io_expander, BIT(GREEN_LED) |
		// 					    BIT(BLUE_LED) |
		// 					    BIT(RED_LED));

		k_delayed_work_cancel(&microphone_work);

		err = nrfx_err_code_check(nrfx_pdm_stop());

		if (err) {
			printk("Error stopping PDM\n");
		} else {
			printk("PDM stopped\n");
		}

                sx1509b_gpio_pin_onoff(io_expander, MIC_PWR, 0);
		// gpio_port_clear_bits_raw(io_expander, BIT(MIC_PWR));
	}
}

static struct button_handler button_handler = {
	.cb = button_handler_cb,
};

static void pdm_event_handler(nrfx_pdm_evt_t const *p_evt)
{
	if (p_evt->error) {
		printk("PDM overflow error\n");
	} else if (p_evt->buffer_requested && p_evt->buffer_released == 0) {
		nrfx_pdm_buffer_set(pdm_buffer_a,
				    sizeof(pdm_buffer_a) /
					    sizeof(pdm_buffer_a[0]));
	} else if (p_evt->buffer_requested &&
		   p_evt->buffer_released == pdm_buffer_a) {
		fft_analyzer_update(pdm_buffer_a, fft_size);
		nrfx_pdm_buffer_set(pdm_buffer_b,
				    sizeof(pdm_buffer_b) /
					    sizeof(pdm_buffer_b[0]));
	} else if (p_evt->buffer_requested &&
		   p_evt->buffer_released == pdm_buffer_b) {
		fft_analyzer_update(pdm_buffer_b, fft_size);
		nrfx_pdm_buffer_set(pdm_buffer_a,
				    sizeof(pdm_buffer_a) /
					    sizeof(pdm_buffer_a[0]));
	}
}

static void button_and_led_init(void)
{
	int err = 0;

	dk_buttons_init(NULL);
	dk_button_handler_add(&button_handler);

	io_expander = device_get_binding(DT_PROP(DT_NODELABEL(sx1509b), label));
        // err |= sx1509b_led_drv_init(io_expander);
        // err |= sx1509b_gpio_output_pin_init(io_expander, GREEN_LED);
        // err |= sx1509b_gpio_output_pin_init(io_expander, BLUE_LED);
        // err |= sx1509b_gpio_output_pin_init(io_expander, RED_LED);
        err |= sx1509b_led_drv_pin_init(io_expander, GREEN_LED);
        err |= sx1509b_led_drv_pin_init(io_expander, BLUE_LED);
        err |= sx1509b_led_drv_pin_init(io_expander, RED_LED);


        printk("PWM_ERROR: %d\n", err);
	if (io_expander == NULL) {
		printk("Could not initiate I/O expander\n");
	}

	// err = gpio_pin_configure(io_expander, GREEN_LED, GPIO_OUTPUT);

	// if (err) {
	// 	printk("Could not configure green LED pin\n");
	// }

	// err = gpio_pin_configure(io_expander, BLUE_LED, GPIO_OUTPUT);

	// if (err) {
	// 	printk("Could not configure blue LED pin\n");
	// }

	// err = gpio_pin_configure(io_expander, RED_LED, GPIO_OUTPUT);

	// if (err) {
	// 	printk("Could not configure red LED pin\n");
	// }
}

static void speaker_init(void)
{
	int err;
	u32_t pwm_period = 1000000U / pwm_frequency;

	gpio_0 = device_get_binding(DT_PROP(DT_NODELABEL(gpio0), label));

	if (gpio_0 == NULL) {
		printk("Could not initiate GPIO 0\n");
		return;
	}

	err = gpio_pin_configure(gpio_0, 29, GPIO_OUTPUT | GPIO_PULL_UP);

	if (err) {
		printk("Could not configure speaker power pin\n");
		return;
	} else {
		printk("Speaker power pin configured\n");
	}

	spkr_pwm = device_get_binding(DT_PROP(DT_NODELABEL(pwm0), label));

	if (spkr_pwm == NULL) {
		printk("Could not initiate speaker PWM\n");
		return;
	} else {
		printk("Speaker PWM (%s) initiated\n", spkr_pwm->name);
	}

	err = pwm_pin_set_usec(spkr_pwm, 27, pwm_period, pwm_period / 2U, 0);

	if (err) {
		printk("Error %d: failed to set PWM values\n", err);
		return;
	}
}

static void microphone_init(void)
{
	int err;

	err = fft_analyzer_configure(fft_size);

	if (err) {
		printk("Error configuring FFT analyzer\n");
	} else {
		printk("FFT analyzer configured\n");
	}

	// err = gpio_pin_configure(io_expander, 9, GPIO_OUTPUT);
        err = sx1509b_gpio_output_pin_init(io_expander, MIC_PWR);


	if (err) {
		printk("Could not configure speaker power pin\n");
		return;
	} else {
		printk("Speaker power pin configured\n");
	}

	// gpio_port_set_bits_raw(io_expander, BIT(MIC_PWR));
        sx1509b_gpio_pin_onoff(io_expander, MIC_PWR, 1);

	pdm_config.gain_l = 70; // 80 (decimal) is max

	err = nrfx_err_code_check(
		nrfx_pdm_init(&pdm_config, pdm_event_handler));

	if (err) {
		printk("Error initiating PDM\n");
	} else {
		printk("PDM initiated\n");
	}

        sx1509b_gpio_pin_onoff(io_expander, MIC_PWR, 0);
	// gpio_port_clear_bits_raw(io_expander, BIT(MIC_PWR));

	k_delayed_work_init(&microphone_work, microphone_work_handler);
}

/** Configuration server definition */
static struct bt_mesh_cfg_srv cfg_srv = {
	.relay = IS_ENABLED(CONFIG_BT_MESH_RELAY),
	.beacon = BT_MESH_BEACON_ENABLED,
	.frnd = IS_ENABLED(CONFIG_BT_MESH_FRIEND),
	.gatt_proxy = IS_ENABLED(CONFIG_BT_MESH_GATT_PROXY),
	.default_ttl = 7,

	/* 3 transmissions with 20ms interval */
	.net_transmit = BT_MESH_TRANSMIT(2, 20),
	.relay_retransmit = BT_MESH_TRANSMIT(2, 20),
};

static void attention_on(struct bt_mesh_model *mod)
{
	int err;

	err = gpio_pin_set_raw(gpio_0, SPKR_PWR, 1);

	if (err) {
		printk("Could not set speaker power pin\n");
		return;
	} else {
		printk("Speaker power on\n");
	}
}

static void attention_off(struct bt_mesh_model *mod)
{
	int err;

	err = gpio_pin_set_raw(gpio_0, SPKR_PWR, 0);

	if (err) {
		printk("Could not set speaker power pin\n");
		return;
	} else {
		printk("Speaker power off\n");
	}
}

static const struct bt_mesh_health_srv_cb health_srv_cb = {
	.attn_on = attention_on,
	.attn_off = attention_off,
};

static struct bt_mesh_health_srv health_srv = {
	.cb = &health_srv_cb,
};

BT_MESH_HEALTH_PUB_DEFINE(health_pub, 0);

static struct bt_mesh_elem elements[] = {
	BT_MESH_ELEM(1,
		     BT_MESH_MODEL_LIST(BT_MESH_MODEL_CFG_SRV(&cfg_srv),
					BT_MESH_MODEL_HEALTH_SRV(&health_srv,
								 &health_pub)),
		     BT_MESH_MODEL_NONE),
};

static const struct bt_mesh_comp comp = {
	.cid = CONFIG_BT_COMPANY_ID,
	.elem = elements,
	.elem_count = ARRAY_SIZE(elements),
};

static struct k_delayed_work orentiation_led_work;
static void orentiation_led(struct k_work *work)
{
        static uint32_t cnt;
        uint8_t red_val = ((cnt >> 0) & 0b11) * 64;
        uint8_t blue_val = ((cnt >> 2) & 0b11) * 64;
        uint8_t green_val = ((cnt >> 4) & 0b11) * 64;
        printk("Current count: %d. Red: %d, Blue: %d, green: %d\n", cnt, red_val, blue_val, green_val);
        sx1509b_set_pwm(io_expander, RED_LED, red_val);
        sx1509b_set_pwm(io_expander, BLUE_LED, blue_val);
        sx1509b_set_pwm(io_expander, GREEN_LED, green_val);
        cnt ++;
        if (cnt > 256)
        {
                cnt= 0;
        }

	k_delayed_work_submit(&orentiation_led_work, K_MSEC(200));
}

const struct bt_mesh_comp *model_handler_init(void)
{
	button_and_led_init();
	speaker_init();
	microphone_init();
	// gpio_pin_set_raw(io_expander, BLUE_LED, 0);
	// gpio_pin_set_raw(io_expander, GREEN_LED, 0);
	// gpio_pin_set_raw(io_expander, RED_LED, 0);
	k_delayed_work_init(&orentiation_led_work, orentiation_led);
	// k_delayed_work_submit(&orentiation_led_work, K_NO_WAIT);
        // sx1509b_set_pwm(io_expander, RED_LED, 255);
        // sx1509b_set_pwm(io_expander, GREEN_LED, 8);
        // sx1509b_set_pwm(io_expander, BLUE_LED, 0);


	return &comp;
}
```

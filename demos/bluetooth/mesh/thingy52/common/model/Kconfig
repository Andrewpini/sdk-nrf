## demos/bluetooth/mesh/thingy52/common/model/Kconfig
```kconfig
#
# Copyright (c) 2020 Nordic Semiconductor ASA
#
# SPDX-License-Identifier: LicenseRef-BSD-5-Clause-Nordic
#

config BT_MESH_THINGY52_SRV
	bool "Thingy:52 Server"
	select BT_MESH_NRF_MODELS
	help
	  Enable Mesh Thingy:52 Server model.

config BT_MESH_THINGY52_CLI
	bool "Thingy:52 Client"
	select BT_MESH_NRF_MODELS
	help
	  Enable Mesh Thingy:52 Client model.
```

## CMakeLists.txt
```
#
# Copyright (c) 2020 Nordic Semiconductor ASA
#
# SPDX-License-Identifier: LicenseRef-BSD-5-Clause-Nordic
#
cmake_minimum_required(VERSION 3.8.2)

find_package(Zephyr REQUIRED HINTS $ENV{ZEPHYR_BASE})
project(NONE)

target_sources(app PRIVATE
	src/main.c
	src/model_handler.c
	src/fft_analyzer.c)
target_include_directories(app PRIVATE include)
```

## sample.yaml
```
sample:
  name: Bluetooth Mesh Thingy52 Whistle Client
  description: Bluetooth Mesh Thingy52 Whistle Client
tests:
  samples.bluetooth.mesh.thingy52_whistle_cli:
    build_only: true
    build_on_all: true
    platform_whitelist: thingy52_nrf52832
    tags: bluetooth ci_build
```

## prj.conf
```kconfig
#
# Copyright (c) 2020 Nordic Semiconductor ASA
#
# SPDX-License-Identifier: LicenseRef-BSD-5-Clause-Nordic
#

# General configuration
CONFIG_SYSTEM_WORKQUEUE_STACK_SIZE=2048
CONFIG_FLASH=y
CONFIG_FLASH_MAP=y
CONFIG_NVS=y
CONFIG_SETTINGS=y
CONFIG_HWINFO=y
CONFIG_LOG=y
CONFIG_USE_SEGGER_RTT=y
CONFIG_LOG_MINIMAL=n
CONFIG_LOG_PRINTK=y

CONFIG_DK_LIBRARY=y
CONFIG_BT_MESH_DK_PROV=y

# I2C
CONFIG_I2C_0=y

# Speaker
CONFIG_PWM=y

# Microphone
CONFIG_NRFX_PDM=y
CONFIG_NEWLIB_LIBC=y
CONFIG_CMSIS_DSP=y
CONFIG_CMSIS_DSP_TRANSFORM=y
CONFIG_CMSIS_DSP_COMPLEXMATH=y

# Thingy52 Orientation handler
CONFIG_I2C_1=y
CONFIG_SENSOR=y
CONFIG_LIS2DH=y
CONFIG_THINGY_ORIENT_HANDLER=y

# Bluetooth configuration
CONFIG_BT=y
CONFIG_BT_COMPANY_ID=0x0059
CONFIG_BT_DEVICE_NAME="Thingy:52 Whistle Client"
CONFIG_BT_L2CAP_RX_MTU=69
CONFIG_BT_L2CAP_TX_MTU=69
CONFIG_BT_L2CAP_TX_BUF_COUNT=8
CONFIG_BT_LL_SW_SPLIT=y
CONFIG_BT_OBSERVER=y
CONFIG_BT_PERIPHERAL=y
CONFIG_BT_SETTINGS=y

# Disable unused Bluetooth features
CONFIG_BT_CTLR_DUP_FILTER_LEN=0
CONFIG_BT_CTLR_LE_ENC=n
CONFIG_BT_DATA_LEN_UPDATE=n
CONFIG_BT_PHY_UPDATE=n
CONFIG_BT_CTLR_CHAN_SEL_2=n
CONFIG_BT_CTLR_MIN_USED_CHAN=n
CONFIG_BT_CTLR_PRIVACY=n

# Bluetooth Mesh configuration
CONFIG_BT_MESH=y
CONFIG_BT_MESH_RELAY=y
CONFIG_BT_MESH_FRIEND=y
CONFIG_BT_MESH_ADV_BUF_COUNT=13
CONFIG_BT_MESH_TX_SEG_MAX=10
CONFIG_BT_MESH_PB_GATT=y
CONFIG_BT_MESH_GATT_PROXY=y

# Bluetooth Mesh models
CONFIG_BT_MESH_WHISTLE_CLI=y
```

## src/main.c
```c
/*
 * Copyright (c) 2020 Nordic Semiconductor ASA
 *
 * SPDX-License-Identifier: LicenseRef-BSD-5-Clause-Nordic
 */

#include <bluetooth/bluetooth.h>
#include <bluetooth/mesh/models.h>
#include <bluetooth/mesh/dk_prov.h>
#include <dk_buttons_and_leds.h>
#include "model_handler.h"

static void bt_ready(int err)
{
	if (err) {
		printk("Bluetooth init failed (err %d)\n", err);
		return;
	}

	printk("Bluetooth initialized\n");

	err = bt_mesh_init(bt_mesh_dk_prov_init(), model_handler_init());
	if (err) {
		printk("Initializing mesh failed (err %d)\n", err);
		return;
	}

	if (IS_ENABLED(CONFIG_SETTINGS)) {
		settings_load();
	}

	/* This will be a no-op if settings_load() loaded provisioning info */
	bt_mesh_prov_enable(BT_MESH_PROV_ADV | BT_MESH_PROV_GATT);

	printk("Mesh initialized\n");
}

ISR_DIRECT_DECLARE(pdm_isr_handler)
{
	nrfx_pdm_irq_handler();
	ISR_DIRECT_PM(); // PM done after servicing interrupt for best latency

	return 1; // We should check if scheduling decision should be made
}

void main(void)
{
	int err;

	printk("Initializing...\n");

	IRQ_DIRECT_CONNECT(PDM_IRQn, 0, pdm_isr_handler, 0);

	err = bt_enable(bt_ready);
	if (err) {
		printk("Bluetooth init failed (err %d)\n", err);
	}
}
```

## src/fft_analyzer.c
```c
/*
  Copyright (c) 2016 Arduino LLC. All right reserved.

  This library is free software; you can redistribute it and/or
  modify it under the terms of the GNU Lesser General Public
  License as published by the Free Software Foundation; either
  version 2.1 of the License, or (at your option) any later version.

  This library is distributed in the hope that it will be useful,
  but WITHOUT ANY WARRANTY; without even the implied warranty of
  MERCHANTABILITY or FITNESS FOR A PARTICULAR PURPOSE. See the GNU
  Lesser General Public License for more details.

  You should have received a copy of the GNU Lesser General Public
  License along with this library; if not, write to the Free Software
  Foundation, Inc., 51 Franklin St, Fifth Floor, Boston, MA 02110-1301 USA
*/

#include "fft_analyzer.h"

static int _length;
static bool _available;
static int *_sample_buffer;
static int _sample_buffer_size;
static int *_fft_buffer;
static int *_spectrum_buffer;

static arm_rfft_instance_q15 _S15;

bool fft_analyzer_available()
{
	return _available;
}

int fft_analyzer_read(int spectrum[], int size)
{
	if (!_available) {
		return FFT_ERROR;
	}

	if (size > (_length / 2)) {
		size = _length / 2;
	}

	q31_t *dst = (q31_t *)spectrum;
	q15_t *src = (q15_t *)_spectrum_buffer;

	for (int i = 0; i < size; i++) {
		*dst++ = *src++;
	}

	_available = false;

	return size;
}

int fft_analyzer_configure(int length)
{
	_length = length;
	_sample_buffer_size = _length * sizeof(q15_t);

	if (ARM_MATH_SUCCESS != arm_rfft_init_q15(&_S15, _length, 0, 1)) {
		return FFT_ERROR;
	}

	_sample_buffer = (int *)calloc(_sample_buffer_size, 1);
	_spectrum_buffer = (int *)calloc(_length, sizeof(q15_t));

	_fft_buffer = (int *)calloc(_sample_buffer_size * 2, 1);

	if (_sample_buffer == NULL || _spectrum_buffer == NULL ||
	    _fft_buffer == NULL) {
		return FFT_ERROR;
	}

	return FFT_NO_ERROR;
}

void fft_analyzer_update(const void *buffer, int size)
{
	if (size > _sample_buffer_size) {
		// more samples than buffer size, cap
		size = _sample_buffer_size;
	}

	int newSamplesOffset = _sample_buffer_size - size;

	if (newSamplesOffset) {
		// shift over the previous samples
		memmove(_sample_buffer, ((uint8_t *)_sample_buffer) + size,
			newSamplesOffset);
	}

	uint8_t *newSamples = ((uint8_t *)_sample_buffer) + newSamplesOffset;

	memcpy(newSamples, buffer, size);

	arm_rfft_q15(&_S15, (q15_t *)_sample_buffer, (q15_t *)_fft_buffer);
	arm_cmplx_mag_q15((q15_t *)_fft_buffer, (q15_t *)_spectrum_buffer,
			  _length);

	_available = true;
}
```

## src/model_handler.c
```c
/*
 * Copyright (c) 2020 Nordic Semiconductor ASA
 *
 * SPDX-License-Identifier: LicenseRef-BSD-5-Clause-Nordic
 */

#include <bluetooth/bluetooth.h>
#include <bluetooth/mesh/models.h>
#include <drivers/gpio.h>
#include <drivers/gpio/gpio_sx1509b.h>
#include <drivers/pwm.h>
#include <dk_buttons_and_leds.h>
#include <thingy52_orientation_handler.h>
#include "model_handler.h"

#define PDM_SAMPLING_FREQ 16000
#define FFT_SIZE 256
#define SPECTRUM_SIZE (FFT_SIZE / 2)
#define SPEAKER_PWM_FREQ 880

struct devices {
	struct device *io_expander;
	struct device *gpio_0;
	struct device *spkr_pwm;
};
static struct devices dev;

struct mic_config {
	nrfx_pdm_config_t pdm_config;
	int16_t pdm_buffer_a[FFT_SIZE];
	int16_t pdm_buffer_b[FFT_SIZE];
	struct k_delayed_work microphone_work;
};
static struct mic_config mic_cfg = {
	.pdm_config = NRFX_PDM_DEFAULT_CONFIG(26, 25),
};

static struct bt_mesh_whistle_rgb curr_rgb;
static uint16_t curr_speed = 200;
struct k_delayed_work rgb_picker_work;
struct k_delayed_work speed_picker_work;
struct k_delayed_work blink_work;

static struct bt_mesh_whistle_cli whistle_cli = BT_MESH_WHISTLE_CLI_INIT;

static int avg_freq;

static inline int nrfx_err_code_check(nrfx_err_t nrfx_err)
{
	return NRFX_ERROR_BASE_NUM - nrfx_err ? true : false;
}

static void set_rgb_led(struct bt_mesh_whistle_rgb rgb)
{
	sx1509b_led_set_pwm_value(dev.io_expander, RED_LED, rgb.red);
	sx1509b_led_set_pwm_value(dev.io_expander, GREEN_LED, rgb.green);
	sx1509b_led_set_pwm_value(dev.io_expander, BLUE_LED, rgb.blue);
}

static void pick_rgb(uint16_t input_val, struct bt_mesh_whistle_rgb *rgb)
{
	uint16_t raw_val = input_val % (6 * 256);
	uint8_t rgb_array[3];

	if (!raw_val)
	{
		memset(rgb_array, 0, sizeof(rgb_array));
		goto end;
	}

	uint8_t domain_idx = ((raw_val - (raw_val % 256)) / 256);
	uint8_t zero_idx = (((4 + domain_idx) - ((4 + domain_idx) % 2)) / 2) % sizeof(rgb_array);
	uint8_t max_idx = (((1 + domain_idx) - ((1 + domain_idx) % 2)) / 2) % sizeof(rgb_array);
	uint8_t working_idx = (1 + (2 * domain_idx )) % sizeof(rgb_array);

	rgb_array[zero_idx] = 0;
	rgb_array[max_idx] = 255;

	if ((domain_idx + 1) % 2) {
		rgb_array[working_idx] = raw_val % 256;
	} else {
		rgb_array[working_idx] = 255 - (raw_val % 256);
	}

	end:
	rgb->red = rgb_array[0];
	rgb->green = rgb_array[1];
	rgb->blue = rgb_array[2];
}

static int bind_devices(void)
{
	dev.spkr_pwm = device_get_binding(DT_PROP(DT_NODELABEL(pwm0), label));
	dev.gpio_0 = device_get_binding(DT_PROP(DT_NODELABEL(gpio0), label));
	dev.io_expander =
		device_get_binding(DT_PROP(DT_NODELABEL(sx1509b), label));

	if ((dev.gpio_0 == NULL) || (dev.spkr_pwm == NULL) ||
	    (dev.io_expander == NULL)) {
		return -1;
	}

	return 0;
}

static void button_handler_cb(u32_t pressed, u32_t changed)
{
	orientation_t orr = thingy52_orientation_get();
	printk("Orientation: %d\n", orr);

	switch (orr) {
	case THINGY_ORIENT_X_UP:
		break;
	case THINGY_ORIENT_Y_UP:
		break;
	case THINGY_ORIENT_Y_DOWN:
		if ((pressed & BIT(0))) {
			k_delayed_work_submit(&speed_picker_work, K_NO_WAIT);

		} else if ((!pressed & BIT(0))) {
			k_delayed_work_cancel(&speed_picker_work);
		}
		break;
	case THINGY_ORIENT_X_DOWN:
		if ((pressed & BIT(0))) {
			k_delayed_work_cancel(&blink_work);
			k_delayed_work_submit(&rgb_picker_work, K_NO_WAIT);

		} else if ((!pressed & BIT(0))) {
			k_delayed_work_cancel(&rgb_picker_work);
			k_delayed_work_submit(&blink_work, K_NO_WAIT);
		}
		break;
	case THINGY_ORIENT_Z_DOWN:

		if ((pressed & BIT(0))) {
			sx1509b_set_pin_value(dev.io_expander, MIC_PWR, 1);
			nrfx_err_code_check(nrfx_pdm_start());
			k_delayed_work_submit(&mic_cfg.microphone_work,
					      K_NO_WAIT);
			printk("Mic Start\n");

		} else if ((!pressed & BIT(0))) {
			k_delayed_work_cancel(&mic_cfg.microphone_work);
			nrfx_err_code_check(nrfx_pdm_stop());
			sx1509b_set_pin_value(dev.io_expander, MIC_PWR, 0);
			printk("Mic Stop\n");
		}
		break;

	case THINGY_ORIENT_Z_UP: {
		struct bt_mesh_whistle_rgb_msg msg;
		msg.ttl = 0x3C;
		msg.delay = curr_speed;
		memcpy(&msg.color, &curr_rgb, sizeof(msg.color));
		msg.speaker_on = false;

		bt_mesh_whistle_cli_rgb_set(&whistle_cli, NULL, &msg);
		break;
	}
	default:
		return;
	}
}

static struct button_handler button_handler = {
	.cb = button_handler_cb,
};

static void button_and_led_init(void)
{
	int err = 0;

	err |= dk_buttons_init(NULL);
	dk_button_handler_add(&button_handler);

	for (int i = GREEN_LED; i <= RED_LED; i++) {
		err |= sx1509b_pin_configure(dev.io_expander, i, SX1509B_PWM);
	}

	if (err) {
		printk("Initializing buttons and leds failed.\n");
	}
}

static void speaker_init(u32_t pwm_frequency)
{
	int err = 0;
	u32_t pwm_period = 1000000U / pwm_frequency;

	err |= gpio_pin_configure(dev.gpio_0, SPKR_PWR,
				  GPIO_OUTPUT | GPIO_PULL_UP);
	err |= pwm_pin_set_usec(dev.spkr_pwm, SPKR_PWM, pwm_period,
				pwm_period / 2U, 0);

	if (err) {
		printk("Initializing speaker failed.\n");
	}
}

static void pdm_event_handler(nrfx_pdm_evt_t const *p_evt)
{
	if (p_evt->error) {
		printk("PDM overflow error\n");
	} else if (p_evt->buffer_requested && p_evt->buffer_released == 0) {
		nrfx_pdm_buffer_set(mic_cfg.pdm_buffer_a,
				    sizeof(mic_cfg.pdm_buffer_a) /
					    sizeof(mic_cfg.pdm_buffer_a[0]));
	} else if (p_evt->buffer_requested &&
		   p_evt->buffer_released == mic_cfg.pdm_buffer_a) {
		fft_analyzer_update(mic_cfg.pdm_buffer_a, FFT_SIZE);
		nrfx_pdm_buffer_set(mic_cfg.pdm_buffer_b,
				    sizeof(mic_cfg.pdm_buffer_b) /
					    sizeof(mic_cfg.pdm_buffer_b[0]));
	} else if (p_evt->buffer_requested &&
		   p_evt->buffer_released == mic_cfg.pdm_buffer_b) {
		fft_analyzer_update(mic_cfg.pdm_buffer_b, FFT_SIZE);
		nrfx_pdm_buffer_set(mic_cfg.pdm_buffer_a,
				    sizeof(mic_cfg.pdm_buffer_a) /
					    sizeof(mic_cfg.pdm_buffer_a[0]));
	}
}

static void microphone_work_handler(struct k_work *work)
{
	static int spectrum[SPECTRUM_SIZE];

	if (fft_analyzer_available()) {
		int counter = 0;
		avg_freq = 0;
		fft_analyzer_read(spectrum, SPECTRUM_SIZE);

		/* i = 8 for frequencies from 500 Hz and up */
		for (int i = 8; i < SPECTRUM_SIZE; i++) {
			if (spectrum[i]) {
				if (!counter) {
					avg_freq = ((i * PDM_SAMPLING_FREQ) /
						    FFT_SIZE);
				} else {
					avg_freq = avg_freq +
						   ((((i * PDM_SAMPLING_FREQ) /
						      FFT_SIZE) -
						     avg_freq) /
						    counter);
				}

				counter++;

			}
		}
			printk("Average frequency: %d\n", avg_freq);
	}

	k_delayed_work_submit(&mic_cfg.microphone_work, K_MSEC(200));
}

static void microphone_init(void)
{
	int err = 0;

	err |= fft_analyzer_configure(FFT_SIZE);
	err |= sx1509b_pin_configure(dev.io_expander, MIC_PWR, SX1509B_OUTPUT);
	mic_cfg.pdm_config.gain_l = 70; // 80 (decimal) is max
	err |= nrfx_err_code_check(
		nrfx_pdm_init(&mic_cfg.pdm_config, pdm_event_handler));

	if (err) {
		printk("Initializing microphone failed.\n");
	}

	k_delayed_work_init(&mic_cfg.microphone_work, microphone_work_handler);
}

static void rgb_picker_work_handler(struct k_work *work)
{
	static uint16_t val;

	pick_rgb(val, &curr_rgb);
	set_rgb_led(curr_rgb);
	val += 16;
	k_delayed_work_submit(&rgb_picker_work, K_MSEC(200));
}

static void speed_picker_work_handler(struct k_work *work)
{
	curr_speed +=50;

	if (curr_speed >= 2000)
	{
		curr_speed = 200;
	}

	k_delayed_work_submit(&speed_picker_work, K_MSEC(200));
}

static void blink_work_handler(struct k_work *work)
{
	static bool onoff;
	onoff = !onoff;

	if (onoff)
	{
		set_rgb_led(curr_rgb);
	}
	else
	{
		struct bt_mesh_whistle_rgb rgb_off = {0,0,0};
		set_rgb_led(rgb_off);
	}

	k_delayed_work_submit(&blink_work, K_MSEC(curr_speed));
}

/** Configuration server definition */
static struct bt_mesh_cfg_srv cfg_srv = {
	.relay = IS_ENABLED(CONFIG_BT_MESH_RELAY),
	.beacon = BT_MESH_BEACON_ENABLED,
	.frnd = IS_ENABLED(CONFIG_BT_MESH_FRIEND),
	.gatt_proxy = IS_ENABLED(CONFIG_BT_MESH_GATT_PROXY),
	.default_ttl = 7,

	/* 3 transmissions with 20ms interval */
	.net_transmit = BT_MESH_TRANSMIT(2, 20),
	.relay_retransmit = BT_MESH_TRANSMIT(2, 20),
};

static void attention_on(struct bt_mesh_model *mod)
{
	for (int i = GREEN_LED; i <= RED_LED; i++) {
		sx1509b_led_set_pwm_value(dev.io_expander, i, 255);
	}
}

static void attention_off(struct bt_mesh_model *mod)
{
	for (int i = GREEN_LED; i <= RED_LED; i++) {
		sx1509b_led_set_pwm_value(dev.io_expander, i, 0);
	}
}

static const struct bt_mesh_health_srv_cb health_srv_cb = {
	.attn_on = attention_on,
	.attn_off = attention_off,
};

static struct bt_mesh_health_srv health_srv = {
	.cb = &health_srv_cb,
};

BT_MESH_HEALTH_PUB_DEFINE(health_pub, 0);

static struct bt_mesh_elem elements[] = {
	BT_MESH_ELEM(1,
		     BT_MESH_MODEL_LIST(BT_MESH_MODEL_CFG_SRV(&cfg_srv),
					BT_MESH_MODEL_HEALTH_SRV(&health_srv,
								 &health_pub)),
		     BT_MESH_MODEL_NONE),
	BT_MESH_ELEM(
		2, BT_MESH_MODEL_NONE,
		BT_MESH_MODEL_LIST(BT_MESH_MODEL_WHISTLE_CLI(&whistle_cli))),
};

static const struct bt_mesh_comp comp = {
	.cid = CONFIG_BT_COMPANY_ID,
	.elem = elements,
	.elem_count = ARRAY_SIZE(elements),
};

const struct bt_mesh_comp *model_handler_init(void)
{
	if (bind_devices()) {
		printk("Failure occured while binding devices\n");
		return &comp;
	}

	button_and_led_init();
	thingy52_orientation_handler_init();
	speaker_init(SPEAKER_PWM_FREQ);
	microphone_init();
	k_delayed_work_init(&rgb_picker_work, rgb_picker_work_handler);
	k_delayed_work_init(&speed_picker_work, speed_picker_work_handler);

	k_delayed_work_init(&blink_work, blink_work_handler);
	k_delayed_work_submit(&blink_work, K_NO_WAIT);


	return &comp;
}
```

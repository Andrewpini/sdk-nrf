## CMakeLists.txt
```
#
# Copyright (c) 2020 Nordic Semiconductor ASA
#
# SPDX-License-Identifier: LicenseRef-BSD-5-Clause-Nordic
#
cmake_minimum_required(VERSION 3.8.2)

find_package(Zephyr REQUIRED HINTS $ENV{ZEPHYR_BASE})
project(NONE)

target_sources(app PRIVATE
	src/main.c)
target_include_directories(app PRIVATE include)
```

## sample.yaml
```
sample:
  name: Thingy52 accelerometer
  description: Thingy52 accelerometer
tests:
  samples.bluetooth.mesh.thingy52_accelerometer_test:
    build_only: true
    build_on_all: true
    platform_whitelist: nrf52dk_nrf52832 nrf52840dk_nrf52840
    tags: bluetooth ci_build
```

## prj.conf
```kconfig
#
# Copyright (c) 2020 Nordic Semiconductor ASA
#
# SPDX-License-Identifier: LicenseRef-BSD-5-Clause-Nordic
#

# General configuration
CONFIG_SYSTEM_WORKQUEUE_STACK_SIZE=2048
CONFIG_FLASH=y
CONFIG_FLASH_MAP=y
CONFIG_NVS=y
CONFIG_SETTINGS=y
CONFIG_HWINFO=y
CONFIG_LOG=y
CONFIG_USE_SEGGER_RTT=y
CONFIG_LOG_MINIMAL=n
CONFIG_LOG_PRINTK=y

CONFIG_DK_LIBRARY=y

CONFIG_I2C_1=y
CONFIG_SENSOR=y
CONFIG_LIS2DH=y
CONFIG_THINGY_ORIENT_HANDLER=y

CONFIG_DK_LIBRARY=y
```

## src/main.c
```c
/*
 * Copyright (c) 2020 Nordic Semiconductor ASA
 *
 * SPDX-License-Identifier: LicenseRef-BSD-5-Clause-Nordic
 */

#include <stdio.h>
#include <zephyr.h>
#include <thingy52_orientation_handler.h>


#include <drivers/gpio.h>
#include <drivers/pwm.h>
#include <dk_buttons_and_leds.h>

#define GREEN_LED 5
#define BLUE_LED 6
#define RED_LED 7
#define MIC_PWR 9
#define SPKR_PWR 29

static struct device *io_expander;

static void led_init(void)
{
	int err;

	io_expander = device_get_binding(DT_PROP(DT_NODELABEL(sx1509b), label));

	if (io_expander == NULL) {
		printk("Could not initiate I/O expander\n");
	}

	err = gpio_pin_configure(io_expander, GREEN_LED, GPIO_OUTPUT);

	if (err) {
		printk("Could not configure green LED pin\n");
	}

	err = gpio_pin_configure(io_expander, BLUE_LED, GPIO_OUTPUT);

	if (err) {
		printk("Could not configure blue LED pin\n");
	}

	err = gpio_pin_configure(io_expander, RED_LED, GPIO_OUTPUT);

	if (err) {
		printk("Could not configure red LED pin\n");
	}
}

void main(void)
{
        led_init();
        thingy52_orientation_handler_init();
        gpio_pin_set_raw(io_expander, BLUE_LED, 0);
	while (true) {

                orientation_t orr = thingy52_orientation_get();

                switch (orr)
                {
                case THINGY_ORIENT_X_UP:
                        gpio_pin_set_raw(io_expander, BLUE_LED, 0);
                        gpio_pin_set_raw(io_expander, GREEN_LED, 1);
                        gpio_pin_set_raw(io_expander, RED_LED, 1);
                        break;
                case THINGY_ORIENT_X_DOWN:
                        gpio_pin_set_raw(io_expander, BLUE_LED, 1);
                        gpio_pin_set_raw(io_expander, GREEN_LED, 0);
                        gpio_pin_set_raw(io_expander, RED_LED, 1);
                        break;
                case THINGY_ORIENT_Y_UP:
                        gpio_pin_set_raw(io_expander, BLUE_LED, 1);
                        gpio_pin_set_raw(io_expander, GREEN_LED, 1);
                        gpio_pin_set_raw(io_expander, RED_LED, 0);
                        break;
                case THINGY_ORIENT_Y_DOWN:
                        gpio_pin_set_raw(io_expander, BLUE_LED, 1);
                        gpio_pin_set_raw(io_expander, GREEN_LED, 0);
                        gpio_pin_set_raw(io_expander, RED_LED, 0);
                        break;
                case THINGY_ORIENT_Z_UP:
                        gpio_pin_set_raw(io_expander, BLUE_LED, 0);
                        gpio_pin_set_raw(io_expander, GREEN_LED, 1);
                        gpio_pin_set_raw(io_expander, RED_LED, 0);
                        break;
                case THINGY_ORIENT_Z_DOWN:
                        gpio_pin_set_raw(io_expander, BLUE_LED, 0);
                        gpio_pin_set_raw(io_expander, GREEN_LED, 0);
                        gpio_pin_set_raw(io_expander, RED_LED, 0);
                        break;
                default:
                        break;
                }

	        // printk("Current orientation: %d\n", orr);
		k_sleep(K_MSEC(30));
	}
}
```
